// SPDX-License-Identifier: GPL-2.0
/*
 *
 * Copyright 2019~2022 MicroPhase Inc.
 */
/dts-v1/;
#include "zynq-e310v2.dtsi"

/ {
	leds {
		compatible = "gpio-leds";
		led0 {
			label = "led0:green";
			gpios = <&gpio0 0 0>;
			linux,default-trigger = "heartbeat";
		};
	};
};
